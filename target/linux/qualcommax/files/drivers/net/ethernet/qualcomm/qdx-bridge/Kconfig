## target/linux/qualcommax/files/drivers/net/ethernet/qualcomm/qdx-bridge/Kconfig
```kconfig
config QDX_BRIDGE
	tristate "QDX bridge path integration"
	depends on QDX && BRIDGE && NET_SWITCHDEV
	help
	  Track the native bridge decisions used by QDX delegated paths.
	  Native bridge forwarding and FDB policy remain with the bridge owner.
```

## target/linux/qualcommax/files/drivers/net/ethernet/qualcomm/qdx-drv/Kconfig
```kconfig
# SPDX-License-Identifier: GPL-2.0-only
config QDX
	tristate "Qualcomm IPQ8074 NSS execution driver"
	depends on ARCH_QCOM && ARM64 && OF
	depends on HAS_DMA && COMMON_CLK && RESET_CONTROLLER && REGULATOR
	depends on MAILBOX && QCOM_APCS_IPC
	depends on !MODULE_FORCE_UNLOAD
	select FW_LOADER
	select CRYPTO_LIB_SHA256
	help
	  Start both IPQ8074 NSS cores with the locally installed 11.4 firmware
	  and provide their command, memory and wired packet transport. Linux
	  networking and the native Ethernet drivers retain configuration
	  ownership. Independent QDX subsystem modules acquire and withdraw
	  hardware delegation while firmware keeps running.

	  The module is called qdx-drv. Once loaded it remains resident until
	  system shutdown; a stopped NSS instance cannot restart in that boot.
```

## target/linux/qualcommax/files/drivers/net/ethernet/qualcomm/qdx-flow/Kconfig
```kconfig
# SPDX-License-Identifier: GPL-2.0-only
config QDX_FLOW
	tristate "QDX routed flowtable offload"
	depends on QDX && NF_FLOW_TABLE && NET_CLS
	help
	  Connect native IPv4/IPv6 flowtable offload to the QDX NSS dataplane.
	  Bridge, VLAN, PPPoE and TC policy remain owned by their corresponding
	  native subsystems and optional QDX peers.
```

## target/linux/qualcommax/files/drivers/net/ethernet/qualcomm/qdx-tc/Kconfig
```kconfig
# SPDX-License-Identifier: GPL-2.0-only
config QDX_TC
	tristate "Qualcomm NSS native TC device stage"
	depends on QDX && NET_SCHED && NET_CLS && NET_CLS_ACT && IFB
	help
	  Translate supported native TC objects into an independently accounted
	  NSS device stage. Native queue algorithms, feature permission and IFB
	  continuation remain with their Linux owners. Unsupported policy stays
	  in software unless the user explicitly requires hardware execution.
```

## target/linux/qualcommax/files/drivers/net/ethernet/qualcomm/qdx-tunnel/Kconfig
```kconfig
config QDX_TUNNEL
	tristate "QDX PPPoE session integration"
	depends on QDX && PPPOE
	help
	  Delegate eligible native PPPoE sessions and preserve their actual
	  protocol, lower-device and final-accounting lifetimes.
```

## target/linux/qualcommax/files/drivers/net/ethernet/qualcomm/qdx-vlan/Kconfig
```kconfig
config QDX_VLAN
	tristate "QDX VLAN path integration"
	depends on QDX && VLAN_8021Q
	help
	  Interpret native VLAN operations at their actual packet positions.
	  Create firmware VLAN endpoints only for explicitly requested lowers.
```
